ENTRY(_start) /** Entry point defined in start.S */

/* ld on the complains if a single PT_LOAD segment if R+W+X, so we split into two.
   Needed now that .bss is no longer empty. */
PHDRS
{
	text PT_LOAD FLAGS(5); /* R + X */
	data PT_LOAD FLAGS(6); /* R + W */
}

SECTIONS
{
	/* QEMU's "virt" machine loads -kernel images at this address */
	. = 0x40000000;

    /* .text.boot comes from start.S and must be aligned to
    0x40000000, thus it comes first in our section ordering.

    All other sections come from main.c or are left empty, except for .note.gnu.build-id,
	which is auto-generated by the linker. */

	.text : { *(.text.boot) *(.text*) } :text
	.rodata : { *(.rodata*) } :text

	/* Page-align to the minimum universal page granule (4 KB).
	Matched by -Wl,-z,max-page-size=0x1000 in the Makefile: without it, ld still *declares*
	64 KB alignment in the ELF's program headers. */
	. = ALIGN(0x1000);

	.data : { *(.data*) } :data

	/* Explicitly placed (rather than left as an orphan section) so it doesn't get
	auto-assigned (either wrongly to :text, or to :data before page alignment). */
	.note.gnu.build-id : { *(.note.gnu.build-id) } :data

	.bss : { *(.bss*) *(COMMON) } :data

    /* Define a stack: the stack starts at its highest reserved address
    and grows downwards */

	. = ALIGN(16);  /* Align the stack pointer to a 16-byte boundary */
	. = . + 0x4000; /* Allocate 16 KB for the stack */
	stack_top = .;  /* Define the top of the stack */
}
